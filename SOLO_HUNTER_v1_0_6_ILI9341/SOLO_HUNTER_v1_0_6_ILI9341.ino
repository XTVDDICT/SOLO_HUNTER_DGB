// SOLO HUNTER v1.0.6 settings-page build for ILI9341 CYD
// Public/shareable build for ILI9341 screen variant
//
// Features:
// - WiFiManager for first-time WiFi setup / recovery
// - local config page after connected
// - edit wallet + screen flip from browser
// - live DGB wallet balance (10s refresh)
// - cached DGB/USD/GBP/CAD prices (5 min refresh)
// - BLOCK FOUND popup on mined tx or confirmed balance increase
// - HELIOS hardware SHA-256d engine with second-core software mining
//
// Required library:
//   WiFiManager by tzapu / tablatronix

#include <WiFi.h>
#include <WiFiClientSecure.h>
#include <HTTPClient.h>
#include <Preferences.h>
#include <LovyanGFX.hpp>
#include <WiFiManager.h>
#include <WebServer.h>
#include "SoloHunterMiner.h"
#include <esp_pm.h>

const char* AP_SSID = "SOLO_HUNTER_SETUP";
const char* AP_PASS = "solohunter";

#define TFT_BL 21
#define REAR_LED 17

static const uint32_t WALLET_REFRESH_MS = 300000;
static const uint32_t FIAT_REFRESH_MS   = 600000;
static const uint32_t MINED_ALERT_REFRESH_MS = 120000;
static const uint32_t MINING_DISPLAY_REFRESH_MS = 1000;

Preferences prefs;
WebServer server(80);

String cfgWallet = "";
String cfgCurrency = "USD";
bool cfgFlip = false;
bool cfgMiningEnabled = false;
String cfgMiningPoolHost = "";
String cfgMiningPoolPort = "3333";
String cfgMiningUser = "";
String cfgMiningWorker = "";
String cfgMiningPass = "x";

String chainzUrl() {
  return String("https://chainz.cryptoid.info/dgb/api.dws?q=getbalance&a=") + cfgWallet;
}

String geckoUrl() {
  return String("https://api.coingecko.com/api/v3/simple/price?ids=digibyte&vs_currencies=usd,gbp,cad");
}

String minedTxUrl() {
  return String("https://www.coinexplorer.net/api/v1/DGB/address/transactions?address=") + cfgWallet;
}

class LGFX : public lgfx::LGFX_Device {
  lgfx::Panel_ILI9341 _panel;
  lgfx::Bus_SPI _bus;
public:
  LGFX(void) {
    {
      auto cfg = _bus.config();
      cfg.spi_host = HSPI_HOST;
      cfg.spi_mode = 0;
      cfg.freq_write = 27000000;
      cfg.freq_read = 16000000;
      cfg.spi_3wire = false;
      cfg.use_lock = true;
      cfg.dma_channel = 1;
      cfg.pin_sclk = 14;
      cfg.pin_mosi = 13;
      cfg.pin_miso = 12;
      cfg.pin_dc   = 2;
      _bus.config(cfg);
      _panel.setBus(&_bus);
    }
    {
      auto cfg = _panel.config();
      cfg.pin_cs = 15;
      cfg.pin_rst = -1;
      cfg.pin_busy = -1;
      cfg.memory_width = 240;
      cfg.memory_height = 320;
      cfg.panel_width = 240;
      cfg.panel_height = 320;
      cfg.offset_x = 0;
      cfg.offset_y = 0;
      cfg.offset_rotation = 0;
      cfg.dummy_read_pixel = 8;
      cfg.dummy_read_bits = 1;
      cfg.readable = true;
      cfg.invert = false;
      cfg.rgb_order = false;
      cfg.dlen_16bit = false;
      cfg.bus_shared = true;
      _panel.config(cfg);
    }
    setPanel(&_panel);
  }
} tft;

static constexpr uint16_t C_BG      = TFT_BLACK;
static constexpr uint16_t C_GREEN   = 0x07E0;
static constexpr uint16_t C_GREEN2  = 0x05A0;
static constexpr uint16_t C_DIM     = 0x7BEF;
static constexpr uint16_t C_WARN    = TFT_YELLOW;
static constexpr uint16_t C_ALERT   = TFT_RED;
static constexpr uint16_t C_POPBG   = 0x0120;

const int IMG_W = 172;
const int IMG_H = 150;
static const uint16_t acceptedImg[IMG_W * IMG_H] PROGMEM = {
  0x0000, 0x0000, 0x0000, 0x0000, 0x0000, 0x0000, 0x0000, 0x0000, 0x0000, 0x0000, 0x0000, 0x0000,
  0x0000, 0x0000, 0x0000, 0x0000, 0x0000, 0x0000, 0x0000, 0x0000, 0x0000, 0x0000, 0x0000, 0x0000,
  0x0000, 0x0000, 0x0000, 0x0000, 0x0000, 0x0000, 0x0000, 0x0000, 0x0000, 0x0000, 0x0000, 0x0000,
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  0x0000, 0x0000, 0x0000, 0x0000, 0x0000, 0x0000, 0x0000, 0x0000, 0x0000, 0x0000, 0x0000, 0x0000
};

float balanceDGB = 0.0f;
float dgbPriceUsd = 0.0f;
float dgbPriceGbp = 0.0f;
float dgbPriceCad = 0.0f;
float walletFiatValue = 0.0f;
float lastBalanceDGB = -1.0f;
float deltaDGB = 0.0f;

bool haveWalletData = false;
bool haveFiatData = false;
bool popupActive = false;
bool popupPersistent = false;
bool portalMode = false;
bool minedBaselineReady = false;

String statusText = "BOOT";
String lastMinedTxId = "";
unsigned long popupUntil = 0;
unsigned long lastWalletFetch = 0;
unsigned long lastFiatFetch = 0;
unsigned long lastMinedAlertCheck = 0;
unsigned long lastMiningDisplayRefresh = 0;

float miningHashrateKh = 0.0f;
uint64_t miningTotalHashes = 0;
uint32_t miningSubmittedShares = 0;
uint32_t miningPendingShares = 0;
uint32_t miningAcceptedShares = 0;
uint32_t miningRejectedShares = 0;
uint32_t miningBlocksFound = 0;
uint32_t miningUptimeSeconds = 0;
double miningBestDiff = 0.0;
double miningPoolDifficulty = 0.0;
bool miningHardwareSha = false;
String miningRuntimeStatus = "OFF";

bool isBlockPopupVisible();

void rearLedOn() {
  digitalWrite(REAR_LED, LOW);
}

String fmt2(float v) {
  char buf[24];
  dtostrf(v, 0, 2, buf);
  return String(buf);
}

String fmtDecimals(float v, uint8_t decimals) {
  char buf[24];
  dtostrf(v, 0, decimals, buf);
  return String(buf);
}

String normalizeCurrency(String currency) {
  currency.trim();
  currency.toUpperCase();
  if (currency == "GBP" || currency == "CAD") return currency;
  return "USD";
}

String currentCurrencyCode() {
  return normalizeCurrency(cfgCurrency);
}

String currencyDisplayName(const String& currencyCode) {
  if (currencyCode == "GBP") return "Great British Pound";
  if (currencyCode == "CAD") return "Canadian Dollar";
  return "US Dollar";
}

String currencyPrefix(const String& currencyCode) {
  if (currencyCode == "GBP") return "\xC2\xA3";
  if (currencyCode == "CAD") return "CAD$";
  return "$";
}

String currencyPrefixHtml(const String& currencyCode) {
  if (currencyCode == "GBP") return "&pound;";
  if (currencyCode == "CAD") return "CAD$";
  return "$";
}

float dgbPriceForCurrency(const String& currencyCode) {
  if (currencyCode == "GBP") return dgbPriceGbp;
  if (currencyCode == "CAD") return dgbPriceCad;
  return dgbPriceUsd;
}

float currentDgbFiatPrice() {
  return dgbPriceForCurrency(currentCurrencyCode());
}

float currentWalletFiatValue() {
  float price = currentDgbFiatPrice();
  if (!(haveWalletData && price > 0.0f)) return 0.0f;
  return balanceDGB * price;
}

void syncFiatAvailability() {
  haveFiatData = (currentDgbFiatPrice() > 0.0f);
}

String currentCurrencyWaitText() {
  return currentCurrencyCode() + " WAIT";
}

String formatFiatAmount(const String& currencyCode, float amount, uint8_t decimals) {
  return currencyPrefix(currencyCode) + fmtDecimals(amount, decimals);
}

String currentFiatAmountText(float amount, uint8_t decimals) {
  return formatFiatAmount(currentCurrencyCode(), amount, decimals);
}

void drawPoundGlyph2x(int x, int y, uint16_t color, uint16_t bg) {
  static const uint8_t poundGlyph[8] = {
    0b001110,
    0b010001,
    0b010000,
    0b111100,
    0b011000,
    0b111100,
    0b010000,
    0b111110
  };

  tft.fillRect(x, y, 12, 16, bg);
  for (int row = 0; row < 8; ++row) {
    for (int col = 0; col < 6; ++col) {
      if (poundGlyph[row] & (1 << (5 - col))) {
        tft.fillRect(x + (col * 2), y + (row * 2), 2, 2, color);
      }
    }
  }
}

String currentCurrencyRetryText() {
  return currentCurrencyCode() + " RETRY";
}

String liveCurrencyWaitStatus() {
  return "LIVE / " + currentCurrencyCode() + " WAIT";
}

float extractJsonFloat(const String& body, const char* key) {
  int pos = body.indexOf(key);
  if (pos < 0) return 0.0f;

  String sub = body.substring(pos + strlen(key));
  int comma = sub.indexOf(",");
  int brace = sub.indexOf("}");
  int end = comma;

  if (end < 0 || (brace >= 0 && brace < end)) end = brace;
  if (end > 0) sub = sub.substring(0, end);
  sub.trim();
  return sub.toFloat();
}

String compactJson(String body) {
  body.replace("\n", "");
  body.replace("\r", "");
  body.replace("\t", "");
  body.replace(" ", "");
  return body;
}

String extractJsonStringValue(const String& body, const char* key) {
  int pos = body.indexOf(key);
  if (pos < 0) return "";
  int start = pos + strlen(key);
  int end = body.indexOf("\"", start);
  if (end < 0 || end <= start) return "";
  return body.substring(start, end);
}

bool extractLatestMinedTx(const String& rawBody, String& txid, float& received) {
  String body = compactJson(rawBody);
  int typePos = body.indexOf("\"type\":\"mined\"");
  if (typePos < 0) return false;

  int objStart = body.lastIndexOf("{", typePos);
  int objEnd = body.indexOf("}", typePos);
  if (objStart < 0 || objEnd < 0 || objEnd <= objStart) return false;

  String obj = body.substring(objStart, objEnd + 1);
  txid = extractJsonStringValue(obj, "\"txid\":\"");
  received = extractJsonStringValue(obj, "\"received\":\"").toFloat();
  if (received <= 0.0f) received = extractJsonFloat(obj, "\"received\":");
  if (received <= 0.0f) received = extractJsonFloat(obj, "\"amount\":");
  if (received <= 0.0f) received = extractJsonFloat(obj, "\"value\":");
  return !txid.isEmpty();
}

String currencyChoiceHtml(const char* code, const char* label, const char* hint) {
  String checked = currentCurrencyCode() == code ? " checked" : "";
  return
    "<label class='choice'>"
      "<input type='radio' name='currency' value='" + String(code) + "'" + checked + ">"
      "<span class='choice-body'>"
        "<span class='choice-code'>" + String(code) + "</span>"
        "<span class='choice-label'>" + String(label) + "</span>"
        "<span class='choice-hint'>" + String(hint) + "</span>"
      "</span>"
    "</label>";
}

void trimConfig() {
  cfgWallet.trim();
  cfgCurrency = normalizeCurrency(cfgCurrency);
  cfgMiningPoolHost.trim();
  cfgMiningPoolPort.trim();
  cfgMiningUser.trim();
  cfgMiningWorker.trim();
  cfgMiningPass.trim();
  if (cfgMiningPoolPort.isEmpty()) cfgMiningPoolPort = "3333";
  if (cfgMiningPass.isEmpty()) cfgMiningPass = "x";
}

void savePrefs() {
  trimConfig();
  prefs.begin("solo", false);
  prefs.putString("wallet", cfgWallet);
  prefs.putString("currency", cfgCurrency);
  prefs.putBool("flip", cfgFlip);
  prefs.putBool("mineen", cfgMiningEnabled);
  prefs.putString("poolhost", cfgMiningPoolHost);
  prefs.putString("poolport", cfgMiningPoolPort);
  prefs.putString("mineuser", cfgMiningUser);
  prefs.putString("worker", cfgMiningWorker);
  prefs.putString("minepass", cfgMiningPass);
  prefs.putString("lastmtx", lastMinedTxId);
  prefs.putBool("minebase", minedBaselineReady);
  prefs.putFloat("lastbal", lastBalanceDGB);
  prefs.putFloat("lastusd", dgbPriceUsd);
  prefs.putFloat("lastgbp", dgbPriceGbp);
  prefs.putFloat("lastcad", dgbPriceCad);
  prefs.end();
}

void loadPrefs() {
  prefs.begin("solo", true);
  cfgWallet = prefs.getString("wallet", "");
  cfgCurrency = prefs.getString("currency", "USD");
  cfgFlip = prefs.getBool("flip", false);
  cfgMiningEnabled = prefs.getBool("mineen", false);
  cfgMiningPoolHost = prefs.getString("poolhost", "");
  cfgMiningPoolPort = prefs.getString("poolport", "3333");
  cfgMiningUser = prefs.getString("mineuser", "");
  cfgMiningWorker = prefs.getString("worker", "");
  cfgMiningPass = prefs.getString("minepass", "x");
  lastMinedTxId = prefs.getString("lastmtx", "");
  minedBaselineReady = prefs.getBool("minebase", false);
  lastBalanceDGB = prefs.getFloat("lastbal", -1.0f);
  dgbPriceUsd = prefs.getFloat("lastusd", 0.0f);
  dgbPriceGbp = prefs.getFloat("lastgbp", 0.0f);
  dgbPriceCad = prefs.getFloat("lastcad", 0.0f);
  prefs.end();
  trimConfig();
  syncFiatAvailability();
}

void saveLastBalance() {
  prefs.begin("solo", false);
  prefs.putFloat("lastbal", lastBalanceDGB);
  prefs.end();
}

void saveMinedAlertState() {
  prefs.begin("solo", false);
  prefs.putString("lastmtx", lastMinedTxId);
  prefs.putBool("minebase", minedBaselineReady);
  prefs.end();
}

void saveLastFiatPrices() {
  prefs.begin("solo", false);
  prefs.putFloat("lastusd", dgbPriceUsd);
  prefs.putFloat("lastgbp", dgbPriceGbp);
  prefs.putFloat("lastcad", dgbPriceCad);
  prefs.end();
}

void applyRotation() {
  tft.setRotation(cfgFlip ? 3 : 1);
}

String currentIpText() {
  if (WiFi.status() == WL_CONNECTED) return WiFi.localIP().toString();
  return "NO WIFI";
}

String htmlEscape(String s) {
  s.replace("&", "&amp;");
  s.replace("<", "&lt;");
  s.replace(">", "&gt;");
  s.replace("\"", "&quot;");
  return s;
}

String jsonEscape(String s) {
  s.replace("\\", "\\\\");
  s.replace("\"", "\\\"");
  s.replace("\n", "\\n");
  s.replace("\r", "\\r");
  return s;
}

SoloHunterMiningConfig currentMiningEngineConfig() {
  SoloHunterMiningConfig config;
  config.enabled = cfgMiningEnabled;
  config.poolHost = cfgMiningPoolHost;
  long port = cfgMiningPoolPort.toInt();
  config.poolPort = (port > 0 && port <= 65535) ? (uint16_t)port : 3333;
  config.username = cfgMiningUser;
  config.worker = cfgMiningWorker;
  config.password = cfgMiningPass;
  return config;
}

void syncMiningStats() {
  SoloHunterMiningStats stats = soloHunterMinerGetStats();
  miningHashrateKh = stats.hashrateKh;
  miningTotalHashes = stats.totalHashes;
  miningSubmittedShares = stats.submittedShares;
  miningPendingShares = stats.pendingShares;
  miningAcceptedShares = stats.acceptedShares;
  miningRejectedShares = stats.rejectedShares;
  miningBlocksFound = stats.blocksFound;
  miningUptimeSeconds = stats.uptimeSeconds;
  miningBestDiff = stats.bestDifficulty;
  miningPoolDifficulty = stats.poolDifficulty;
  miningHardwareSha = stats.hardwareSha;
  miningRuntimeStatus = stats.status;
}

String formatMiningHashrate() {
  return String((uint32_t)lroundf(miningHashrateKh)) + "KH";
}

String uint64Text(uint64_t value) {
  char text[24];
  snprintf(text, sizeof(text), "%llu", (unsigned long long)value);
  return String(text);
}

String formatMiningTotalHashes() {
  if (miningTotalHashes >= 1000000000ULL) {
    return fmtDecimals((float)miningTotalHashes / 1000000000.0f, 2) + "B";
  }
  if (miningTotalHashes >= 1000000ULL) {
    return fmtDecimals((float)miningTotalHashes / 1000000.0f, 2) + "M";
  }
  if (miningTotalHashes >= 1000ULL) {
    return fmtDecimals((float)miningTotalHashes / 1000.0f, 2) + "K";
  }
  return uint64Text(miningTotalHashes);
}

String formatMiningUptime() {
  uint32_t hours = miningUptimeSeconds / 3600U;
  uint32_t minutes = (miningUptimeSeconds / 60U) % 60U;
  uint32_t seconds = miningUptimeSeconds % 60U;
  char text[24];
  snprintf(text, sizeof(text), "%02lu:%02lu:%02lu",
           (unsigned long)hours, (unsigned long)minutes,
           (unsigned long)seconds);
  return String(text);
}

String formatMiningDiff() {
  if (miningBestDiff >= 1000000.0) return fmtDecimals((float)(miningBestDiff / 1000000.0), 2) + "M";
  if (miningBestDiff >= 1000.0) return fmtDecimals((float)(miningBestDiff / 1000.0), 2) + "K";
  if (miningBestDiff >= 1.0) return fmtDecimals((float)miningBestDiff, 2);
  if (miningBestDiff > 0.0) return fmtDecimals((float)miningBestDiff, 6);
  return fmtDecimals((float)miningBestDiff, 2);
}

String formatMiningDiffCompact() {
  if (miningBestDiff >= 1.0) return formatMiningDiff();
  if (miningBestDiff <= 0.0) return "0.00";
  if (miningBestDiff < 0.0001) return "<.0001";
  return fmtDecimals((float)miningBestDiff, 4);
}

void drawMiningStats() {
  syncMiningStats();
  if (!cfgMiningEnabled) return;

  tft.fillRect(38, 56, 36, 60, C_BG);
  tft.setTextSize(1);
  tft.setTextColor(C_GREEN, C_BG);
  tft.setCursor(38, 58);
  tft.print(formatMiningHashrate());
  tft.setCursor(38, 70);
  tft.print(miningAcceptedShares);
  tft.setCursor(38, 82);
  tft.print(miningRejectedShares);
  tft.setCursor(38, 94);
  tft.print(formatMiningDiffCompact());
  tft.setCursor(38, 106);
  tft.print(miningBlocksFound);
}

void drawBorder() {
  // Semi-thick neon border
  tft.drawRect(0, 0, 320, 240, C_GREEN);
  tft.drawRect(1, 1, 318, 238, C_GREEN);
  tft.drawRect(2, 2, 316, 236, C_GREEN2);
  tft.drawRect(3, 3, 314, 234, C_GREEN2);
}

void drawStaticLayout() {
  tft.fillScreen(C_BG);
  drawBorder();

  tft.setTextColor(C_GREEN, C_BG);
  tft.setTextSize(2);
  tft.setCursor(74, 10);
  tft.print("__SOLO_HUNTER__");

  int imgX = (320 - IMG_W) / 2;
  int imgY = 34;

  tft.setSwapBytes(true);
  tft.pushImage(imgX, imgY, IMG_W, IMG_H, acceptedImg);
  tft.setSwapBytes(false);
  tft.fillRect(6, 50, 68, 70, C_BG);
  if (cfgMiningEnabled) {
    tft.setTextSize(1);
    tft.setTextColor(C_GREEN, C_BG);
    tft.setCursor(8, 58);
    tft.print("HASH");
    tft.setCursor(8, 70);
    tft.print("ACC");
    tft.setCursor(8, 82);
    tft.print("REJ");
    tft.setCursor(8, 94);
    tft.print("BEST");
    tft.setCursor(8, 106);
    tft.print("BLK");
  }
  drawMiningStats();

  tft.drawFastHLine(20, 180, 280, C_GREEN2);
  tft.drawFastHLine(20, 222, 280, C_GREEN2);

  tft.setTextSize(1);
  tft.setTextColor(C_DIM, C_BG);
  tft.setCursor(24, 186);
  tft.print("DGB BAL");
  String fiatLabel = currentCurrencyCode() + " VALUE";
  int fiatLabelX = 296 - tft.textWidth(fiatLabel);
  if (fiatLabelX < 216) fiatLabelX = 216;
  tft.setCursor(fiatLabelX, 186);
  tft.print(fiatLabel);
  tft.setCursor(24, 226);
  tft.print("STATUS");
}

void drawValues() {
  tft.fillRect(20, 194, 280, 24, C_BG);
  tft.setTextSize(2);
  walletFiatValue = 0.0f;

  if (haveWalletData) {
    tft.setTextColor(C_GREEN, C_BG);
    tft.setCursor(24, 196);
    tft.print(fmt2(balanceDGB));

    String currencyCode = currentCurrencyCode();
    String fiatText = currentCurrencyWaitText();
    bool drawCustomPound = false;
    String fiatAmountText = "";
    if (haveFiatData) {
      walletFiatValue = currentWalletFiatValue();
      if (currencyCode == "GBP") {
        fiatAmountText = fmt2(walletFiatValue);
        drawCustomPound = true;
      } else {
        fiatText = currentFiatAmountText(walletFiatValue, 2);
      }
      tft.setTextColor(C_GREEN, C_BG);
    } else {
      tft.setTextColor(C_WARN, C_BG);
    }

    if (drawCustomPound) {
      const int poundWidth = 12;
      const int poundGap = 2;
      int amountX = 296 - tft.textWidth(fiatAmountText);
      int poundX = amountX - poundGap - poundWidth;

      if (poundX < 144) {
        poundX = 144;
        amountX = poundX + poundWidth + poundGap;
      }

      drawPoundGlyph2x(poundX, 196, C_GREEN, C_BG);
      tft.setCursor(amountX, 196);
      tft.print(fiatAmountText);
    } else {
      int fiatX = 296 - tft.textWidth(fiatText);
      if (fiatX < 144) fiatX = 144;
      tft.setCursor(fiatX, 196);
      tft.print(fiatText);
    }
  } else {
    if (WiFi.status() == WL_CONNECTED && cfgWallet.isEmpty()) {
      tft.setTextSize(1);
      tft.setTextColor(C_WARN, C_BG);
      tft.setCursor(24, 203);
      tft.print("CONNECT TO ");
      tft.setTextColor(C_GREEN, C_BG);
      tft.print(WiFi.localIP().toString());
    } else {
      tft.setTextColor(C_WARN, C_BG);
      tft.setCursor(24, 196);
      tft.print("NO DATA");
    }
  }

  tft.fillRect(78, 224, 222, 12, C_BG);
  tft.setTextSize(1);
  tft.setTextColor(statusText.startsWith("LIVE") ? C_GREEN : C_ALERT, C_BG);
  tft.setCursor(78, 226);
  tft.print(statusText);
  drawMiningStats();
}

void drawBlockPopup() {
  if (!isBlockPopupVisible()) return;

  int w = 240;
  int h = 90;
  int x = (320 - w) / 2;
  int y = (240 - h) / 2;

  tft.fillRoundRect(x, y, w, h, 12, C_POPBG);
  tft.drawRoundRect(x, y, w, h, 12, C_GREEN);
  tft.drawRoundRect(x + 1, y + 1, w - 2, h - 2, 12, C_GREEN2);

  tft.setTextColor(C_WARN, C_POPBG);
  tft.setTextSize(2);
  tft.setCursor(x + 40, y + 15);
  tft.print("BLOCK FOUND");

  tft.setTextColor(C_GREEN, C_POPBG);
  tft.setTextSize(2);

  String reward = "+" + fmt2(deltaDGB) + " DGB";
  int16_t textWidth = reward.length() * 12;
  int textX = x + (w - textWidth) / 2;

  tft.setCursor(textX, y + 50);
  tft.print(reward);
}

void startBlockPopup(float amount) {
  deltaDGB = amount;
  popupActive = true;
  popupPersistent = true;
  popupUntil = 0;
  drawBlockPopup();
}

bool isBlockPopupVisible() {
  return popupActive && (popupPersistent || millis() < popupUntil);
}

void clearBlockPopup() {
  popupActive = false;
  popupPersistent = false;
  popupUntil = 0;
  drawStaticLayout();
  drawValues();
}

bool fetchDgbBalance() {
  if (WiFi.status() != WL_CONNECTED) {
    statusText = "BAL RETRY";
    return false;
  }

  if (cfgWallet.isEmpty()) {
    statusText = "NO WALLET CONFIG";
    return false;
  }

  WiFiClientSecure client;
  client.setInsecure();
  HTTPClient http;
  http.setConnectTimeout(5000);
  http.setTimeout(10000);
  http.setUserAgent("ESP32-SOLO-HUNTER/1.0.6");

  if (!http.begin(client, chainzUrl())) {
    statusText = "BAL RETRY";
    return false;
  }

  int code = http.GET();
  if (code != 200) {
    statusText = "BAL HTTP " + String(code);
    http.end();
    return false;
  }

  String body = http.getString();
  http.end();
  body.trim();

  if (!body.length() || body.startsWith("ERROR")) {
    statusText = "BAL RETRY";
    return false;
  }

  balanceDGB = body.toFloat();
  haveWalletData = true;
  return true;
}

bool fetchDgbFiatPrices() {
  if (WiFi.status() != WL_CONNECTED) {
    statusText = haveWalletData ? liveCurrencyWaitStatus() : currentCurrencyRetryText();
    return false;
  }

  WiFiClientSecure client;
  client.setInsecure();
  HTTPClient http;
  http.setConnectTimeout(5000);
  http.setTimeout(10000);
  http.setUserAgent("ESP32-SOLO-HUNTER/1.0.6");

  if (!http.begin(client, geckoUrl())) {
    statusText = haveWalletData ? liveCurrencyWaitStatus() : currentCurrencyRetryText();
    return false;
  }

  int code = http.GET();
  if (code == 429) {
    statusText = haveWalletData ? liveCurrencyWaitStatus() : currentCurrencyRetryText();
    http.end();
    return false;
  }
  if (code != 200) {
    statusText = haveWalletData ? liveCurrencyWaitStatus() : currentCurrencyCode() + " HTTP " + String(code);
    http.end();
    return false;
  }

  String body = http.getString();
  http.end();

  bool updated = false;
  float newUsd = extractJsonFloat(body, "\"usd\":");
  float newGbp = extractJsonFloat(body, "\"gbp\":");
  float newCad = extractJsonFloat(body, "\"cad\":");

  if (newUsd > 0.0f) {
    dgbPriceUsd = newUsd;
    updated = true;
  }
  if (newGbp > 0.0f) {
    dgbPriceGbp = newGbp;
    updated = true;
  }
  if (newCad > 0.0f) {
    dgbPriceCad = newCad;
    updated = true;
  }

  if (updated) {
    saveLastFiatPrices();
    syncFiatAvailability();
    return haveFiatData;
  }

  syncFiatAvailability();
  statusText = haveWalletData ? liveCurrencyWaitStatus() : currentCurrencyCode() + " PARSE FAIL";
  return false;
}

bool fetchLatestMinedTx(String& txid, float& received) {
  if (WiFi.status() != WL_CONNECTED || cfgWallet.isEmpty()) return false;

  WiFiClientSecure client;
  client.setInsecure();
  HTTPClient http;
  http.setConnectTimeout(5000);
  http.setTimeout(10000);
  http.setUserAgent("ESP32-SOLO-HUNTER/1.0.6");

  if (!http.begin(client, minedTxUrl())) return false;

  int code = http.GET();
  if (code != 200) {
    http.end();
    return false;
  }

  String body = http.getString();
  http.end();
  return extractLatestMinedTx(body, txid, received);
}

void checkForMinedBlockAlert() {
  if (WiFi.status() != WL_CONNECTED || cfgWallet.isEmpty()) return;

  String txid;
  float received = 0.0f;
  bool foundMinedTx = fetchLatestMinedTx(txid, received);

  if (!minedBaselineReady) {
    if (foundMinedTx) lastMinedTxId = txid;
    minedBaselineReady = true;
    saveMinedAlertState();
    return;
  }

  if (!foundMinedTx || txid.isEmpty() || txid == lastMinedTxId) return;

  lastMinedTxId = txid;
  if (received > 0.0f || !popupActive) {
    startBlockPopup(received);
  }
  saveMinedAlertState();
}

void refreshWalletOnly() {
  bool balOk = fetchDgbBalance();
  if (balOk) {
    statusText = "LIVE " + WiFi.localIP().toString();

    if (lastBalanceDGB < 0.0f) {
      lastBalanceDGB = balanceDGB;
      saveLastBalance();
    } else if (balanceDGB != lastBalanceDGB) {
      if (balanceDGB > lastBalanceDGB) {
        startBlockPopup(balanceDGB - lastBalanceDGB);
      }
      lastBalanceDGB = balanceDGB;
      saveLastBalance();
    }
  } else if (haveWalletData) {
    statusText = "LIVE / BAL RETRY";
  }
}

void refreshFiatOnly() {
  if (!haveWalletData || cfgWallet.isEmpty()) return;
  bool fiatOk = fetchDgbFiatPrices();
  if (fiatOk) {
    statusText = "LIVE " + WiFi.localIP().toString();
  } else if (haveWalletData && haveFiatData) {
    statusText = liveCurrencyWaitStatus();
  }
}

void handleRoot() {
  syncMiningStats();
  String currencyCode = currentCurrencyCode();
  String walletBalanceText = haveWalletData ? fmt2(balanceDGB) + " DGB" : (cfgWallet.isEmpty() ? "Add wallet address" : "Waiting for wallet");
  String walletValueText = haveWalletData && haveFiatData ? currencyPrefixHtml(currencyCode) + fmtDecimals(currentWalletFiatValue(), 2) : (haveWalletData ? currentCurrencyWaitText() : "--");
  String priceText = haveFiatData ? currencyPrefixHtml(currencyCode) + fmtDecimals(currentDgbFiatPrice(), 4) : currentCurrencyWaitText();
  String screenModeText = cfgFlip ? "Flipped 180" : "Standard";
  String miningStateText = cfgMiningEnabled ? miningRuntimeStatus : "OFF";
  String miningPoolText = cfgMiningPoolHost.isEmpty() ? "No pool configured" : cfgMiningPoolHost + ":" + cfgMiningPoolPort;
  String miningHashrateText = formatMiningHashrate();
  String miningTotalHashesText = formatMiningTotalHashes();
  String miningUptimeText = formatMiningUptime();
  String miningBestText = formatMiningDiffCompact();
  String miningEngineText =
      cfgMiningEnabled ? (miningHardwareSha ? "HW SHA" : "CPU FALLBACK") : "OFF";

  String page;
  page.reserve(14000);
  page += "<!doctype html><html><head><meta name='viewport' content='width=device-width,initial-scale=1'>";
  page += "<title>SOLO HUNTER v1.0.6 Control Panel</title>";
  page += "<style>";
  page += ":root{--bg:#07110b;--panel:#101a13;--panel-2:#152319;--line:#294433;--accent:#62ff9b;--accent-2:#1cc86d;--text:#edf7f0;--muted:#9db5a5;--shadow:0 24px 60px rgba(0,0,0,.35)}";
  page += "*{box-sizing:border-box}body{margin:0;min-height:100vh;padding:24px;color:var(--text);font-family:'Trebuchet MS','Segoe UI',sans-serif;background:radial-gradient(circle at top,#16301d 0,#08100a 58%,#050806 100%)}";
  page += "body::before{content:'';position:fixed;inset:0;background:linear-gradient(135deg,rgba(98,255,155,.08),transparent 42%),radial-gradient(circle at top right,rgba(98,255,155,.16),transparent 30%);pointer-events:none}";
  page += ".shell{max-width:1080px;margin:0 auto;display:grid;gap:18px;position:relative;z-index:1}.panel{background:linear-gradient(180deg,rgba(21,35,25,.98),rgba(10,18,12,.94));border:1px solid var(--line);border-radius:24px;padding:22px;box-shadow:var(--shadow)}";
  page += ".hero{padding:28px}.eyebrow{text-transform:uppercase;letter-spacing:.18em;font-size:12px;color:var(--accent)}h1{margin:8px 0 10px;font-size:clamp(28px,5vw,44px);line-height:1.04}.hero-copy,.section-head p,.action-panel p{margin:0;color:var(--muted);line-height:1.55}";
  page += ".chip-row{display:flex;flex-wrap:wrap;gap:10px;margin-top:18px}.pill{display:inline-flex;align-items:center;padding:10px 14px;border-radius:999px;background:rgba(98,255,155,.08);border:1px solid rgba(98,255,155,.22);color:#e4ffed;font-size:14px}";
  page += ".layout{display:grid;grid-template-columns:1.08fr .92fr;gap:18px}.section-head{display:flex;justify-content:space-between;align-items:flex-start;gap:12px;margin-bottom:18px}.section-head h2,.action-panel h2{margin:0 0 6px;font-size:22px}.section-pills{display:flex;justify-content:flex-end;gap:10px;flex-wrap:wrap}";
  page += ".tabs{display:grid;gap:18px}.tabbar{display:flex;gap:10px;flex-wrap:wrap}.tab-button{background:#0b140e;color:var(--text);border:1px solid #35533f;box-shadow:none}.tab-button.active{background:linear-gradient(135deg,var(--accent),var(--accent-2));color:#041109}.tab-pane{display:none}.tab-pane.active{display:block}.field-grid{display:grid;grid-template-columns:repeat(2,minmax(0,1fr));gap:14px}.full{grid-column:1/-1}";
  page += ".stats{display:grid;grid-template-columns:repeat(2,minmax(0,1fr));gap:14px}.stat{padding:16px;border-radius:18px;background:linear-gradient(180deg,rgba(7,17,11,.82),rgba(12,22,15,.95));border:1px solid rgba(98,255,155,.12)}.mining-stats{grid-template-columns:repeat(2,minmax(0,1fr))}.mining-stats .stat strong{font-size:22px}.miner-meta{display:grid;grid-template-columns:repeat(2,minmax(0,1fr));gap:10px;margin-top:14px}.miner-meta div{padding:11px 12px;border-top:1px solid var(--line)}.miner-meta span{display:block;color:var(--muted);font-size:11px;text-transform:uppercase}.miner-meta strong{display:block;margin-top:5px;font-size:14px;overflow-wrap:anywhere}";
  page += ".stat-label{display:block;font-size:12px;text-transform:uppercase;letter-spacing:.08em;color:var(--muted);margin-bottom:10px}.stat strong{display:block;font-size:28px;line-height:1.1;margin-bottom:8px}.stat small{color:var(--muted);font-size:13px}";
  page += ".field-label{display:block;font-size:13px;text-transform:uppercase;letter-spacing:.08em;color:var(--muted);margin-bottom:10px}input{width:100%;padding:14px 16px;border-radius:16px;border:1px solid #35533f;background:#0b140e;color:var(--text);font-size:15px;outline:none}";
  page += "input:focus{border-color:var(--accent);box-shadow:0 0 0 3px rgba(98,255,155,.12)}.choices{display:grid;grid-template-columns:repeat(3,minmax(0,1fr));gap:12px;margin-bottom:18px}.choice{display:block;position:relative;cursor:pointer}";
  page += ".choice input{position:absolute;opacity:0;pointer-events:none}.choice-body{display:block;padding:16px;border-radius:18px;border:1px solid #35533f;background:#0b140e;transition:transform .15s ease,border-color .15s ease,box-shadow .15s ease}";
  page += ".choice input:checked + .choice-body{border-color:var(--accent);box-shadow:0 0 0 3px rgba(98,255,155,.16);transform:translateY(-1px)}.choice-code{display:block;font-size:20px;font-weight:700;margin-bottom:8px}.choice-label{display:block;font-size:14px;font-weight:700;margin-bottom:6px}.choice-hint{display:block;font-size:12px;color:var(--muted);line-height:1.45}";
  page += ".toggle-row{display:grid;gap:12px;margin:18px 0 22px}.toggle{display:flex;align-items:center;gap:12px;padding:14px 16px;border-radius:16px;background:#0b140e;border:1px solid #2e4936}.toggle input{width:18px;height:18px;accent-color:var(--accent-2);margin:0}";
  page += ".actions{display:flex;gap:12px;flex-wrap:wrap}button{appearance:none;border:none;border-radius:16px;padding:14px 18px;font-weight:700;font-size:15px;cursor:pointer;transition:transform .15s ease,box-shadow .15s ease}button:hover{transform:translateY(-1px)}";
  page += ".primary{background:linear-gradient(135deg,var(--accent),var(--accent-2));color:#041109;box-shadow:0 12px 30px rgba(28,200,109,.25)}.secondary{background:#0b140e;color:var(--text);border:1px solid #35533f}.action-panel{display:flex;justify-content:space-between;align-items:center;gap:16px}";
  page += "@media (max-width:900px){body{padding:16px}.layout,.field-grid{grid-template-columns:1fr}.stats,.choices{grid-template-columns:1fr}.mining-stats,.miner-meta{grid-template-columns:repeat(2,minmax(0,1fr))}.action-panel{flex-direction:column;align-items:flex-start}}@media (max-width:520px){.mining-stats,.miner-meta{grid-template-columns:1fr}}";
  page += "</style></head><body><main class='shell'>";
  page += "<section class='hero panel'><div class='eyebrow'>SOLO HUNTER v1.0.6 Control Panel</div>";
  page += "<h1>Display setup and SHA-256 mining settings.</h1>";
  page += "<p class='hero-copy'>Use the Display tab for wallet, currency, and screen settings. Use the Mining tab for pool login details.</p>";
  page += "<div class='chip-row'>";
  page += "<span class='pill' id='ci'>IP: " + htmlEscape(currentIpText()) + "</span>";
  page += "<span class='pill' id='cs'>Status: " + htmlEscape(statusText) + "</span>";
  page += "<span class='pill' id='cc'>Currency: " + htmlEscape(currencyCode) + " | " + htmlEscape(currencyDisplayName(currencyCode)) + "</span>";
  page += "</div></section>";
  page += "<section class='panel tabs'><div class='tabbar'>";
  page += "<button class='tab-button active' type='button' data-tab='display'>Display</button>";
  page += "<button class='tab-button' type='button' data-tab='mining'>Mining</button>";
  page += "</div><div id='tab-display' class='tab-pane active'><section class='layout'>";
  page += "<div class='panel'><div class='section-head'><div><h2>Live Dashboard</h2><p>Selected currency drives both the screen value and the live browser stats below.</p></div><span class='pill'>" + htmlEscape(currencyDisplayName(currencyCode)) + "</span></div>";
  page += "<div class='stats'>";
  page += "<article class='stat'><span class='stat-label'>Wallet Balance</span><strong id='bd'>" + htmlEscape(walletBalanceText) + "</strong><small>Current DigiByte balance from Chainz.</small></article>";
  page += "<article class='stat'><span class='stat-label'>Wallet Value</span><strong id='wf'>" + walletValueText + "</strong><small>The value currently shown on the device.</small></article>";
  page += "<article class='stat'><span class='stat-label'>DGB Price</span><strong id='pf'>" + priceText + "</strong><small>Latest CoinGecko market price in the selected currency.</small></article>";
  page += "<article class='stat'><span class='stat-label'>Screen Mode</span><strong id='sm'>" + htmlEscape(screenModeText) + "</strong><small>Current display orientation.</small></article>";
  page += "</div></div>";
  page += "<div class='panel'><div class='section-head'><div><h2>Device Settings</h2><p>Everything important is on one page so the device is easier to configure and check at a glance.</p></div></div>";
  page += "<form method='POST' action='/save'>";
  page += "<input type='hidden' name='section' value='display'>";
  page += "<label class='field-label' for='wallet'>DGB Wallet Address</label>";
  page += "<input id='wallet' name='wallet' value='" + htmlEscape(cfgWallet) + "' placeholder='Enter your DigiByte wallet address'>";
  page += "<div class='field-label'>Display Currency</div>";
  page += "<div class='choices'>";
  page += currencyChoiceHtml("USD", "US Dollar", "Standard US dollar wallet value");
  page += currencyChoiceHtml("GBP", "Great British Pound", "British pound wallet value");
  page += currencyChoiceHtml("CAD", "Canadian Dollar", "Canadian dollar wallet value");
  page += "</div>";
  page += "<div class='toggle-row'>";
  page += "<label class='toggle'><input type='checkbox' name='flip' " + String(cfgFlip ? "checked" : "") + "><span>Flip screen 180&deg;</span></label>";
  page += "</div>";
  page += "<div class='actions'><button class='primary' type='submit'>Save Settings</button></div>";
  page += "</form></div></section></div>";
  page += "<div id='tab-mining' class='tab-pane'>";
  page += "<section class='layout'>";
  page += "<div class='panel'><div class='section-head'><div><h2>Mining Dashboard</h2><p>Live SHA-256 mining data.</p></div><div class='section-pills'><span class='pill' id='ms0'>" + htmlEscape(miningStateText) + "</span><span class='pill' id='mp0'>" + htmlEscape(miningPoolText) + "</span></div></div>";
  page += "<div class='stats mining-stats'>";
  page += "<article class='stat'><span class='stat-label'>Hashrate</span><strong id='mh'>" + htmlEscape(miningHashrateText) + "</strong><small>Current SHA-256 hashing speed.</small></article>";
  page += "<article class='stat'><span class='stat-label'>Hash Engine</span><strong id='me'>" + htmlEscape(miningEngineText) + "</strong></article>";
  page += "<article class='stat'><span class='stat-label'>Session Hashes</span><strong id='mt'>" + htmlEscape(miningTotalHashesText) + "</strong></article>";
  page += "<article class='stat'><span class='stat-label'>Session Uptime</span><strong id='mu'>" + htmlEscape(miningUptimeText) + "</strong></article>";
  page += "<article class='stat'><span class='stat-label'>Accepted Shares</span><strong id='ma'>" + String(miningAcceptedShares) + "</strong></article>";
  page += "<article class='stat'><span class='stat-label'>Rejected Shares</span><strong id='mr'>" + String(miningRejectedShares) + "</strong></article>";
  page += "<article class='stat'><span class='stat-label'>Submitted Shares</span><strong id='ms'>" + String(miningSubmittedShares) + "</strong></article>";
  page += "<article class='stat'><span class='stat-label'>Pending Shares</span><strong id='mp'>" + String(miningPendingShares) + "</strong></article>";
  page += "<article class='stat'><span class='stat-label'>Blocks Found</span><strong id='mb'>" + String(miningBlocksFound) + "</strong><small>Network-target hashes this run.</small></article>";
  page += "<article class='stat'><span class='stat-label'>Best Difficulty</span><strong id='md'>" + htmlEscape(miningBestText) + "</strong></article>";
  page += "<article class='stat'><span class='stat-label'>Pool Difficulty</span><strong id='mpd'>" + htmlEscape(fmtDecimals((float)miningPoolDifficulty, 4)) + "</strong></article>";
  page += "</div><div class='miner-meta'><div><span>Worker</span><strong id='mw'>" + htmlEscape(cfgMiningWorker.isEmpty() ? "--" : cfgMiningWorker) + "</strong></div><div><span>Firmware</span><strong id='mv'>v1.0.6 / HELIOS-ENGINE</strong></div></div></div>";
  page += "<div class='panel'><div class='section-head'><div><h2>Mining Settings</h2><p>Pool login for SHA-256 mining mode.</p></div></div>";
  page += "<form method='POST' action='/save'>";
  page += "<input type='hidden' name='section' value='mining'>";
  page += "<div class='toggle-row'>";
  page += "<label class='toggle'><input type='checkbox' name='mining_enabled' " + String(cfgMiningEnabled ? "checked" : "") + "><span>Enable SHA-256 mining mode</span></label>";
  page += "</div>";
  page += "<div class='field-grid'>";
  page += "<div><label class='field-label' for='mine_host'>Pool Host</label><input id='mine_host' name='mine_host' value='" + htmlEscape(cfgMiningPoolHost) + "' placeholder='sha256.pool.example'></div>";
  page += "<div><label class='field-label' for='mine_port'>Pool Port</label><input id='mine_port' name='mine_port' value='" + htmlEscape(cfgMiningPoolPort) + "' placeholder='3333'></div>";
  page += "<div class='full'><label class='field-label' for='mine_user'>Wallet / Username</label><input id='mine_user' name='mine_user' value='" + htmlEscape(cfgMiningUser) + "' placeholder='Wallet address or pool username'></div>";
  page += "<div><label class='field-label' for='mine_worker'>Worker Name</label><input id='mine_worker' name='mine_worker' value='" + htmlEscape(cfgMiningWorker) + "' placeholder='solo-hunter-01'></div>";
  page += "<div><label class='field-label' for='mine_pass'>Pool Password</label><input id='mine_pass' name='mine_pass' value='" + htmlEscape(cfgMiningPass) + "' placeholder='x'></div>";
  page += "</div>";
  page += "<div class='actions' style='margin-top:18px'><button class='primary' type='submit'>Save Mining Settings</button></div>";
  page += "</form></div></section></div></section>";
  page += "<section class='panel action-panel'><div><h2>Block Alert</h2><p>Dismiss the device block alert.</p></div>";
  page += "<form method='POST' action='/clear-popup'><button class='secondary' type='submit'>Clear Block Alert</button></form></section>";
  page += "<section class='panel action-panel'><div><h2>WiFi Setup</h2><p>Reopen the WiFi setup portal.</p></div>";
  page += "<form method='POST' action='/wifi'><button class='secondary' type='submit'>Open WiFi Setup</button></form></section>";
  page += "<script>";
  page += "const showTab=(name)=>{document.querySelectorAll('.tab-button').forEach((b)=>b.classList.toggle('active',b.dataset.tab===name));";
  page += "document.querySelectorAll('.tab-pane').forEach((pane)=>pane.classList.toggle('active',pane.id==='tab-'+name));};";
  page += "document.querySelectorAll('.tab-button').forEach((button)=>button.addEventListener('click',()=>{showTab(button.dataset.tab);location.hash=button.dataset.tab;}));";
  page += "showTab(location.hash==='#mining'?'mining':'display');";
  page += "const fmt=(n,d=2)=>Number.isFinite(n)?n.toFixed(d):'--';";
  page += "const prefix=(c)=>c==='GBP'?'\\u00A3':(c==='CAD'?'CAD$':'$');";
  page += "const hashFmt=(n)=>Number.isFinite(n)?Math.round(n)+'KH':'--';";
  page += "const countFmt=(n)=>Number.isFinite(n)?(n>=1e9?(n/1e9).toFixed(2)+'B':(n>=1e6?(n/1e6).toFixed(2)+'M':(n>=1e3?(n/1e3).toFixed(2)+'K':Math.round(n)))):'--';";
  page += "const uptimeFmt=(n)=>{n=Math.max(0,Math.floor(Number(n)||0));const h=Math.floor(n/3600),m=Math.floor(n/60)%60,s=n%60;return [h,m,s].map(v=>String(v).padStart(2,'0')).join(':');};";
  page += "const diffFmt=(n)=>Number.isFinite(n)?(n>=1000000?(n/1000000).toFixed(2)+'M':(n>=1000?(n/1000).toFixed(2)+'K':(n>=1?n.toFixed(2):(n>=0.0001?n.toFixed(4):(n>0?'<0.0001':'0.00'))))):'--';";
  page += "const el=id=>document.getElementById(id);";
  page += "async function refreshStatus(){try{const res=await fetch('/status',{cache:'no-store'});if(!res.ok)return;const s=await res.json();";
  page += "el('ci').textContent='IP: '+(s.ip||'NO WIFI');";
  page += "el('cs').textContent='Status: '+(s.status||'BOOT');";
  page += "el('cc').textContent='Currency: '+(s.currency||'USD')+' | '+(s.currency_name||'US Dollar');";
  page += "el('bd').textContent=s.have_wallet_data?fmt(s.balance_dgb)+' DGB':((s.wallet_configured?'Waiting for wallet':'Add wallet address'));";
  page += "el('wf').textContent=s.have_wallet_data&&s.have_fiat_data?(prefix(s.currency)+fmt(s.wallet_fiat)):((s.currency||'USD')+' WAIT');";
  page += "el('pf').textContent=s.have_fiat_data?(prefix(s.currency)+fmt(s.dgb_fiat,4)):((s.currency||'USD')+' WAIT');";
  page += "el('sm').textContent=s.flip?'Flipped 180':'Standard';";
  page += "el('ms0').textContent=s.mining_enabled?(s.mining_status||'STARTING'):'OFF';";
  page += "el('mp0').textContent=s.mining_pool?`${s.mining_pool}:${s.mining_pool_port}`:'No pool configured';";
  page += "el('mh').textContent=hashFmt(s.mining_hashrate_kh);";
  page += "el('me').textContent=s.mining_enabled?(s.mining_engine||'CPU FALLBACK'):'OFF';";
  page += "el('mt').textContent=countFmt(s.mining_total_hashes);";
  page += "el('mu').textContent=uptimeFmt(s.mining_uptime_seconds);";
  page += "el('ma').textContent=s.mining_accepted_shares||0;";
  page += "el('mr').textContent=s.mining_rejected_shares||0;";
  page += "el('ms').textContent=s.mining_submitted_shares||0;";
  page += "el('mp').textContent=s.mining_pending_shares||0;";
  page += "el('mb').textContent=s.mining_blocks_found||0;";
  page += "el('md').textContent=diffFmt(s.mining_best_diff);";
  page += "el('mpd').textContent=diffFmt(s.mining_pool_difficulty);";
  page += "el('mw').textContent=s.mining_worker||'--';";
  page += "el('mv').textContent='v'+(s.firmware_version||'1.0.6')+' / '+(s.mining_build||'HELIOS-ENGINE');";
  page += "}catch(e){}}refreshStatus();setInterval(refreshStatus,1000);";
  page += "</script></main></body></html>";
  server.send(200, "text/html", page);
}

void handleSave() {
  String saveSection = server.hasArg("section") ? server.arg("section") : "display";
  String oldWallet = cfgWallet;
  bool displaySave = (saveSection != "mining");

  if (displaySave) {
    if (server.hasArg("wallet")) cfgWallet = server.arg("wallet");
    if (server.hasArg("currency")) cfgCurrency = server.arg("currency");
    cfgFlip = server.hasArg("flip");
  } else {
    cfgMiningEnabled = server.hasArg("mining_enabled");
    if (server.hasArg("mine_host")) cfgMiningPoolHost = server.arg("mine_host");
    if (server.hasArg("mine_port")) cfgMiningPoolPort = server.arg("mine_port");
    if (server.hasArg("mine_user")) cfgMiningUser = server.arg("mine_user");
    if (server.hasArg("mine_worker")) cfgMiningWorker = server.arg("mine_worker");
    if (server.hasArg("mine_pass")) cfgMiningPass = server.arg("mine_pass");
  }

  trimConfig();
  bool walletChanged = (cfgWallet != oldWallet);

  if (displaySave && walletChanged) {
    haveWalletData = false;
    popupActive = false;
    popupPersistent = false;
    popupUntil = 0;
    deltaDGB = 0.0f;
    lastBalanceDGB = -1.0f;
    lastMinedTxId = "";
    minedBaselineReady = false;
  }

  syncFiatAvailability();
  savePrefs();
  if (!displaySave) soloHunterMinerConfigure(currentMiningEngineConfig());
  applyRotation();

  if (displaySave && WiFi.status() == WL_CONNECTED) {
    refreshWalletOnly();
    refreshFiatOnly();
    checkForMinedBlockAlert();
  }

  drawStaticLayout();
  drawValues();
  lastWalletFetch = millis();
  lastFiatFetch = millis();
  lastMinedAlertCheck = millis();

  server.sendHeader("Location", displaySave ? "/" : "/#mining", true);
  server.send(303, "text/plain", "");
}

void handleOpenWifiPortal() {
  portalMode = true;
  server.send(200, "text/html",
    "<!doctype html><html><head><meta name='viewport' content='width=device-width,initial-scale=1'>"
    "<title>WiFi Setup Requested</title>"
    "<style>body{margin:0;min-height:100vh;display:grid;place-items:center;background:#08100a;color:#edf7f0;font-family:'Trebuchet MS','Segoe UI',sans-serif;padding:20px}"
    ".card{max-width:520px;padding:24px;border-radius:22px;background:linear-gradient(180deg,#152319,#0b140e);border:1px solid #294433;box-shadow:0 24px 60px rgba(0,0,0,.35)}"
    "h2{margin:0 0 10px;color:#62ff9b}p{margin:0;color:#9db5a5;line-height:1.6}</style></head><body><div class='card'>"
    "<h2>WiFi portal requested.</h2><p>The device is switching into setup mode now. Connect to the SOLO_HUNTER_SETUP network if prompted.</p>"
    "</div></body></html>");
}

void handleClearPopup() {
  clearBlockPopup();
  server.sendHeader("Location", "/", true);
  server.send(303, "text/plain", "");
}

void handleStatusJson() {
  syncFiatAvailability();
  syncMiningStats();
  walletFiatValue = currentWalletFiatValue();
  String currencyCode = currentCurrencyCode();
  String json = "{";
  json += "\"ip\":\"" + jsonEscape(currentIpText()) + "\",";
  json += "\"status\":\"" + jsonEscape(statusText) + "\",";
  json += "\"currency\":\"" + jsonEscape(currencyCode) + "\",";
  json += "\"currency_name\":\"" + jsonEscape(currencyDisplayName(currencyCode)) + "\",";
  json += "\"balance_dgb\":" + String(balanceDGB, 8) + ",";
  json += "\"dgb_usd\":" + String(dgbPriceUsd, 8) + ",";
  json += "\"dgb_gbp\":" + String(dgbPriceGbp, 8) + ",";
  json += "\"dgb_cad\":" + String(dgbPriceCad, 8) + ",";
  json += "\"dgb_fiat\":" + String(currentDgbFiatPrice(), 8) + ",";
  json += "\"wallet_fiat\":" + String(walletFiatValue, 8) + ",";
  json += "\"wallet_usd\":" + String(balanceDGB * dgbPriceUsd, 8) + ",";
  json += "\"wallet_configured\":" + String(cfgWallet.isEmpty() ? "false" : "true") + ",";
  json += "\"have_wallet_data\":" + String(haveWalletData ? "true" : "false") + ",";
  json += "\"have_fiat_data\":" + String(haveFiatData ? "true" : "false") + ",";
  json += "\"mining_enabled\":" + String(cfgMiningEnabled ? "true" : "false") + ",";
  json += "\"mining_status\":\"" + jsonEscape(miningRuntimeStatus) + "\",";
  json += "\"mining_pool\":\"" + jsonEscape(cfgMiningPoolHost) + "\",";
  json += "\"mining_pool_port\":" + cfgMiningPoolPort + ",";
  json += "\"mining_worker\":\"" + jsonEscape(cfgMiningWorker) + "\",";
  json += "\"mining_engine\":\"" + String(cfgMiningEnabled ? (miningHardwareSha ? "HW SHA" : "CPU FALLBACK") : "OFF") + "\",";
  json += "\"mining_hashrate_kh\":" + String(miningHashrateKh, 3) + ",";
  json += "\"mining_total_hashes\":" + uint64Text(miningTotalHashes) + ",";
  json += "\"mining_submitted_shares\":" + String(miningSubmittedShares) + ",";
  json += "\"mining_pending_shares\":" + String(miningPendingShares) + ",";
  json += "\"mining_accepted_shares\":" + String(miningAcceptedShares) + ",";
  json += "\"mining_rejected_shares\":" + String(miningRejectedShares) + ",";
  json += "\"mining_blocks_found\":" + String(miningBlocksFound) + ",";
  json += "\"mining_uptime_seconds\":" + String(miningUptimeSeconds) + ",";
  json += "\"mining_best_diff\":" + String(miningBestDiff, 4) + ",";
  json += "\"mining_pool_difficulty\":" + String(miningPoolDifficulty, 6) + ",";
  json += "\"firmware_version\":\"1.0.6\",";
  json += "\"mining_build\":\"HELIOS-ENGINE\",";
  json += "\"flip\":" + String(cfgFlip ? "true" : "false");
  json += "}";
  server.send(200, "application/json", json);
}

void setupWebServer() {
  server.on("/", HTTP_GET, handleRoot);
  server.on("/save", HTTP_POST, handleSave);
  server.on("/clear-popup", HTTP_POST, handleClearPopup);
  server.on("/wifi", HTTP_POST, handleOpenWifiPortal);
  server.on("/status", HTTP_GET, handleStatusJson);
  server.begin();
}

void runWifiManagerPortal() {
  WiFiManager wm;
  portalMode = true;
  drawStaticLayout();
  statusText = "CONNECT TO SOLO_HUNTER_SETUP WIFI";
  drawValues();
  wm.setConfigPortalTimeout(180);
  bool connected = wm.autoConnect(AP_SSID, AP_PASS);

  if (!connected) {
    statusText = "WIFI PORTAL TIMEOUT";
    drawValues();
    return;
  }

  portalMode = false;
  statusText = cfgWallet.isEmpty() ? "NO WALLET CONFIG" : "LIVE " + WiFi.localIP().toString();
  drawValues();
}

// Keep display/network work on core 0, above the software helper, as in HELIOS.
static TaskHandle_t soloForegroundTaskHandle = nullptr;
static esp_pm_lock_handle_t soloMiningPowerLock = nullptr;
static esp_pm_lock_handle_t soloCpuFrequencyLock = nullptr;
void serviceSoloForeground();

void soloForegroundTask(void*) {
  for (;;) serviceSoloForeground();
}

void setup() {
  pinMode(TFT_BL, OUTPUT);
  digitalWrite(TFT_BL, HIGH);

  pinMode(REAR_LED, OUTPUT);
  rearLedOn();

  tft.init();
  loadPrefs();
  applyRotation();
  tft.setTextDatum(top_left);
  tft.fillScreen(C_BG);

  drawStaticLayout();
  statusText = "STARTING WIFI...";
  drawValues();

  if (WiFi.status() != WL_CONNECTED) {
    runWifiManagerPortal();
  }

  setupWebServer();

  if (WiFi.status() == WL_CONNECTED) {
    refreshWalletOnly();
    refreshFiatOnly();
    checkForMinedBlockAlert();
  }

  drawStaticLayout();
  drawValues();

  if (isBlockPopupVisible()) drawBlockPopup();

  lastWalletFetch = millis();
  lastFiatFetch = millis();
  lastMinedAlertCheck = millis();
  lastMiningDisplayRefresh = millis();

  WiFi.setSleep(false);
  if (esp_pm_lock_create(ESP_PM_NO_LIGHT_SLEEP, 0, "solo-miner",
                         &soloMiningPowerLock) == ESP_OK) {
    esp_pm_lock_acquire(soloMiningPowerLock);
  }
  if (esp_pm_lock_create(ESP_PM_CPU_FREQ_MAX, 0, "solo-cpu",
                         &soloCpuFrequencyLock) == ESP_OK) {
    esp_pm_lock_acquire(soloCpuFrequencyLock);
  }
  soloHunterMinerBegin(currentMiningEngineConfig());
  BaseType_t created = xTaskCreatePinnedToCore(
      soloForegroundTask, "solo-ui", 12288, nullptr, 2,
      &soloForegroundTaskHandle, 0);
  if (created != pdPASS) {
    soloForegroundTaskHandle = nullptr;
    // Share core 1 fairly with the miner if the foreground task cannot start.
    vTaskPrioritySet(nullptr, 2);
  }
}

void loop() {
  if (soloForegroundTaskHandle == nullptr) {
    serviceSoloForeground();
  } else {
    delay(1000);
  }
}

void serviceSoloForeground() {
  rearLedOn();
  server.handleClient();

  if (portalMode) {
    runWifiManagerPortal();
    drawStaticLayout();
    drawValues();
  }

  if (WiFi.status() != WL_CONNECTED) {
    delay(100);
    return;
  }

  if (popupActive) {
    if (!isBlockPopupVisible()) {
      clearBlockPopup();
    } else {
      delay(20);
      return;
    }
  }

  if (millis() - lastMiningDisplayRefresh >= MINING_DISPLAY_REFRESH_MS) {
    lastMiningDisplayRefresh = millis();
    drawMiningStats();
  }

  if (millis() - lastWalletFetch >= WALLET_REFRESH_MS) {
    lastWalletFetch = millis();
    refreshWalletOnly();
    drawValues();
  }

  if (millis() - lastFiatFetch >= FIAT_REFRESH_MS) {
    lastFiatFetch = millis();
    refreshFiatOnly();
    drawValues();
  }

  if (millis() - lastMinedAlertCheck >= MINED_ALERT_REFRESH_MS) {
    lastMinedAlertCheck = millis();
    checkForMinedBlockAlert();
    if (isBlockPopupVisible()) drawBlockPopup();
  }

  delay(20);
}
